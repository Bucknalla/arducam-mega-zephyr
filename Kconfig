## Kconfig
```kconfig
# Copyright (c) 2024, Arducam MEGA Zephyr Driver Contributors
# SPDX-License-Identifier: Apache-2.0

rsource "drivers/video/Kconfig"
```

## drivers/video/Kconfig
```kconfig
config VIDEO_ARDUCAM_MEGA
	bool "Arducam MEGA SPI camera driver"
	default y
	depends on DT_HAS_ARDUCAM_MEGA_ENABLED
	select SPI
	select VIDEO
	help
	  Enable driver for the Arducam MEGA series SPI camera modules
	  (3MP and 5MP variants).

	  The driver implements the Zephyr video subsystem API and
	  communicates with the camera over a 4-wire SPI bus at up to
	  8 MHz (SPI mode 0).

	  Captured frames are placed into caller-supplied video_buffer
	  objects via the standard enqueue/dequeue API.
```

## dts/bindings/video/arducam,mega.yaml
```yaml
# Copyright (c) 2024, Arducam MEGA Zephyr Driver Contributors
# SPDX-License-Identifier: Apache-2.0

description: |
  Arducam MEGA SPI camera module.

  This binding covers the Arducam MEGA 3MP (B0371) and 5MP (B0434)
  camera modules. Both variants use the same SPI command protocol
  and differ only in supported resolutions and sensor characteristics.

  Example device tree node:

    &spi1 {
      arducam_mega: camera@0 {
        compatible = "arducam,mega";
        reg = <0>;
        spi-max-frequency = <8000000>;
        label = "ARDUCAM_MEGA";
      };
    };

compatible: "arducam,mega"

include: [spi-device.yaml]

properties:
  spi-max-frequency:
    required: true
    description: |
      Maximum SPI clock frequency in Hz. The Arducam MEGA supports
      up to 8 000 000 Hz (8 MHz). Do not exceed this value.
```

## tests/unit/testcase.yaml
```yaml
tests:
  drivers.video.arducam_mega.unit:
    tags:
      - video
      - arducam
      - drivers
    arch_allow:
      - x86
      - arm
      - posix
    platform_allow:
      - native_sim
      - native_sim/native/64
      - qemu_x86
    integration_platforms:
      - native_sim
    build_only: false
    harness: ztest
    harness_config:
      type: one_line
      regex:
        - "PROJECT EXECUTION SUCCESSFUL"
```

## west.yml
```yaml
manifest:
  version: "0.13"

  # -----------------------------------------------------------------------
  # Remotes
  # -----------------------------------------------------------------------
  remotes:
    - name: zephyrproject-rtos
      url-base: https://github.com/zephyrproject-rtos

    - name: arducam-mega-zephyr
      url-base: https://github.com/Bucknalla

  # -----------------------------------------------------------------------
  # Projects
  # -----------------------------------------------------------------------
  projects:
    # Zephyr RTOS kernel + drivers
    - name: zephyr
      remote: zephyrproject-rtos
      revision: v3.7.0
      import:
        # Pull in the default Zephyr west extensions (hal_*, crypto, …)
        - name: west.yml

    # This module itself (when used as part of a larger workspace)
    - name: arducam-mega-zephyr
      remote: arducam-mega-zephyr
      revision: main
      path: modules/arducam-mega-zephyr

  # -----------------------------------------------------------------------
  # Self – the manifest repository
  # -----------------------------------------------------------------------
  self:
    path: arducam-mega-zephyr
    west-commands: scripts/west-commands.yml
```
